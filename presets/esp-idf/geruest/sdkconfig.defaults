## presets/zephyr/geruest/tests/filter/testcase.yaml
```yaml
tests:
  app.filter:
    tags: unit
    platform_allow:
      - native_sim
      - native_sim/native/64
    integration_platforms:
      - native_sim
```
