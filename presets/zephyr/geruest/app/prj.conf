## CMakeLists.txt
```
cmake_minimum_required(VERSION 3.20.0)

find_package(Zephyr REQUIRED HINTS $ENV{ZEPHYR_BASE})
project(app LANGUAGES C)

target_sources(app PRIVATE
  src/main.c
  src/filter.c
)
```

## prj.conf
```kconfig
CONFIG_LOG=y
CONFIG_ASSERT=y
```

## src/main.c
```c
#include <zephyr/kernel.h>
#include <zephyr/logging/log.h>

#include "filter.h"

LOG_MODULE_REGISTER(app, LOG_LEVEL_INF);

int main(void)
{
	struct mavg f;

	mavg_init(&f);
	LOG_INF("app started on %s", CONFIG_BOARD);

	while (true) {
		int32_t sample = (int32_t)(k_uptime_get_32() % 100U);

		LOG_INF("sample=%d avg=%d", (int)sample, (int)mavg_update(&f, sample));
		k_sleep(K_SECONDS(1));
	}

	return 0;
}
```

## src/filter.c
```c
#include "filter.h"

#include <string.h>

void mavg_init(struct mavg *f)
{
	memset(f, 0, sizeof(*f));
}

int32_t mavg_update(struct mavg *f, int32_t sample)
{
	if (f->count == MAVG_WINDOW) {
		f->sum -= f->buf[f->idx];
	} else {
		f->count++;
	}
	f->buf[f->idx] = sample;
	f->sum += sample;
	f->idx = (f->idx + 1U) % MAVG_WINDOW;

	return (int32_t)(f->sum / (int64_t)f->count);
}
```

## src/filter.h
```c
/* Pure logic, no Zephyr APIs: unit-testable on native_sim (tests/filter). */
#ifndef APP_FILTER_H_
#define APP_FILTER_H_

#include <stdint.h>

#define MAVG_WINDOW 4

struct mavg {
	int32_t buf[MAVG_WINDOW];
	int64_t sum;
	uint32_t idx;
	uint32_t count;
};

void mavg_init(struct mavg *f);

/* Adds a sample and returns the mean of the last min(count, MAVG_WINDOW) samples. */
int32_t mavg_update(struct mavg *f, int32_t sample);

#endif /* APP_FILTER_H_ */
```
